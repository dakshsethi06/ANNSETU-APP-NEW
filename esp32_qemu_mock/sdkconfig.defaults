## esp32_qemu_mock/sdkconfig.defaults
```kconfig
CONFIG_ETH_USE_OPENETH=y

CONFIG_ESP_HTTPS_OTA_ALLOW_HTTP=y


CONFIG_PARTITION_TABLE_TWO_OTA=y
CONFIG_PARTITION_TABLE_CUSTOM=n

CONFIG_ESPTOOLPY_FLASHSIZE_4MB=y
CONFIG_ESPTOOLPY_FLASHSIZE="4MB"
```
